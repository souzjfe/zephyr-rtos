## boards/nucleo_g474re.conf
```kconfig
# Misc
CONFIG_HEAP_MEM_POOL_SIZE=8192
CONFIG_SHELL_STACK_SIZE=4096

# Enable Shell
CONFIG_SHELL=y

# Setting the Shell prompt
CONFIG_SHELL_PROMPT_UART="~ "

# Setting the max argc
CONFIG_SHELL_ARGC_MAX=12

# Enable the Zephyr boot banner
CONFIG_BOOT_BANNER=y

# Enable GPIO
CONFIG_GPIO=y

# enable runtime status
CONFIG_THREAD_RUNTIME_STATS=y

CONFIG_LOG=y
CONFIG_LOG_MODE_MINIMAL=y
CONFIG_BOOT_BANNER=n
CONFIG_MAIN_THREAD_PRIORITY=5
CONFIG_THREAD_NAME=y
CONFIG_ZBUS=y
CONFIG_ZBUS_LOG_LEVEL_INF=y
CONFIG_ZBUS_CHANNEL_NAME=y
CONFIG_ZBUS_OBSERVER_NAME=y
CONFIG_ZBUS_RUNTIME_OBSERVERS=y
CONFIG_ASSERT=y
CONFIG_DAC=y
```
